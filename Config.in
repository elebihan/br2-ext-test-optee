## Config.in
```kconfig
menu "Security"
source "$BR2_EXTERNAL_TEST_OPTEE_PATH/package/hello-ta/Config.in"
endmenu
```

## configs/qemu_aarch64_virt_optee_defconfig
```kconfig
BR2_aarch64=y
BR2_TOOLCHAIN_EXTERNAL=y
BR2_TOOLCHAIN_EXTERNAL_GDB_SERVER_COPY=y
BR2_TARGET_GENERIC_GETTY_PORT="ttyAMA0"
BR2_SYSTEM_DHCP="eth0"
BR2_ROOTFS_POST_IMAGE_SCRIPT="board/qemu/post-image.sh $(BR2_EXTERNAL_TEST_OPTEE_PATH)/board/qemu/aarch64-virt/post-image.sh"
BR2_ROOTFS_POST_SCRIPT_ARGS="$(BR2_DEFCONFIG)"
BR2_LINUX_KERNEL=y
BR2_LINUX_KERNEL_CUSTOM_VERSION=y
BR2_LINUX_KERNEL_CUSTOM_VERSION_VALUE="5.15"
BR2_LINUX_KERNEL_USE_CUSTOM_CONFIG=y
BR2_LINUX_KERNEL_CUSTOM_CONFIG_FILE="$(BR2_EXTERNAL_TEST_OPTEE_PATH)/board/qemu/aarch64-virt/linux-5.15.config"
BR2_LINUX_KERNEL_VMLINUX=y
BR2_LINUX_KERNEL_NEEDS_HOST_OPENSSL=y
BR2_PACKAGE_STRACE=y
BR2_PACKAGE_LIBGLIB2=y
BR2_PACKAGE_OPTEE_EXAMPLES=y
BR2_TARGET_ROOTFS_CPIO=y
BR2_TARGET_ROOTFS_CPIO_GZIP=y
# BR2_TARGET_ROOTFS_TAR is not set
BR2_TARGET_ARM_TRUSTED_FIRMWARE=y
BR2_TARGET_ARM_TRUSTED_FIRMWARE_PLATFORM="qemu"
BR2_TARGET_ARM_TRUSTED_FIRMWARE_FIP=y
BR2_TARGET_ARM_TRUSTED_FIRMWARE_BL32_OPTEE=y
BR2_TARGET_ARM_TRUSTED_FIRMWARE_UBOOT_AS_BL33=y
BR2_TARGET_ARM_TRUSTED_FIRMWARE_ADDITIONAL_VARIABLES="QEMU_USE_GIC_DRIVQEMU_USE_GIC_DRIVER=QEMU_GICV2 ARM_TSP_RAM_LOCATION=tdram BL32_RAM_LOCATION=tdram DEBUG=0 LOG_LEVEL=30"
BR2_TARGET_OPTEE_OS=y
BR2_TARGET_OPTEE_OS_PLATFORM="vexpress-qemu_armv8a"
BR2_TARGET_OPTEE_OS_ADDITIONAL_VARIABLES="CFG_TEE_CORE_LOG_LEVEL=3 DEBUG=0 CFG_TEE_BENCHMARK=n DEBUG=0 CFG_ARM_GICV3=n CFG_TEE_TA_LOG_LEVEL=4 TA_PUBLIC_KEY=$(BR2_EXTERNAL_TEST_OPTEE_PATH)/vault/optee.pubkey.pem"
BR2_TARGET_UBOOT=y
BR2_TARGET_UBOOT_BOARD_DEFCONFIG="qemu_arm64"
BR2_TARGET_UBOOT_CONFIG_FRAGMENT_FILES="$(BR2_EXTERNAL_TEST_OPTEE_PATH)/board/qemu/aarch64-virt/u-boot.conf"
BR2_PACKAGE_HOST_E2FSPROGS=y
BR2_PACKAGE_HOST_QEMU=y
BR2_PACKAGE_HOST_QEMU_SYSTEM_MODE=y
BR2_PACKAGE_HOST_UBOOT_TOOLS=y
BR2_PACKAGE_HELLO_TA=y
BR2_PACKAGE_HELLO_TA_SIGN_TA=y
BR2_PACKAGE_HELLO_TA_UUID="0925282b-f986-4bc5-a444-ee8b4532ae76"
BR2_PACKAGE_HELLO_TA_SIGN_TA_PRIV_KEY="$(BR2_EXTERNAL_TEST_OPTEE_PATH)/vault/optee.privkey.pem"
BR2_PACKAGE_HELLO_TA_SIGN_TA_PUB_KEY="$(BR2_EXTERNAL_TEST_OPTEE_PATH)/vault/optee.pubkey.pem"
```

## package/hello-ta/Config.in
```kconfig
menuconfig BR2_PACKAGE_HELLO_TA
	bool "hello-ta"
	help
	  OP-TEE Trusted Application example

if BR2_PACKAGE_HELLO_TA

config BR2_PACKAGE_HELLO_TA_SIGN_TA
	bool "Sign TA with custom key"
	help
	  Sign the TA with a custom RSA-2048 key

if BR2_PACKAGE_HELLO_TA_SIGN_TA

config BR2_PACKAGE_HELLO_TA_UUID
	string "TA UUID"
	help
	  UUID of the TA

config BR2_PACKAGE_HELLO_TA_SIGN_TA_PRIV_KEY
	string "Private key file"
	help
	  Path to private key file

config BR2_PACKAGE_HELLO_TA_SIGN_TA_PUB_KEY
	string "Public key file"
	help
	  Path to public key file

endif

endif
```
